#include "modbus.h"
#include "sys.h"
#include "stm32f1xx_hal_usart.h"

/* Table of CRC values for high-order byte */
static const unsigned char array_crc_low[] =
    {
        0x00, 0xC1, 0x81, 0x40, 0x01, 0xC0, 0x80, 0x41, 0x01, 0xC0,
        0x80, 0x41, 0x00, 0xC1, 0x81, 0x40, 0x01, 0xC0, 0x80, 0x41,
        0x00, 0xC1, 0x81, 0x40, 0x00, 0xC1, 0x81, 0x40, 0x01, 0xC0,
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        0x80, 0x41, 0x00, 0xC1, 0x81, 0x40};
/* Table of CRC values for low-order byte */
static const unsigned char array_crc_high[] =
    {
        0x00, 0xC0, 0xC1, 0x01, 0xC3, 0x03, 0x02, 0xC2, 0xC6, 0x06,
        0x07, 0xC7, 0x05, 0xC5, 0xC4, 0x04, 0xCC, 0x0C, 0x0D, 0xCD,
        0x0F, 0xCF, 0xCE, 0x0E, 0x0A, 0xCA, 0xCB, 0x0B, 0xC9, 0x09,
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        0x43, 0x83, 0x41, 0x81, 0x80, 0x40};

uint16_t CRC16(const uint8_t *pbuf, int len)
{
    uint8_t crc_high, crc_low;
    uint32_t index;
    crc_high = crc_low = 0xff;
    while (len-- > 0)
    {
        index = crc_low ^ *pbuf++;
        crc_low = crc_high ^ array_crc_low[index];
        crc_high = array_crc_high[index];
    }
    return (crc_low + (crc_high << 8));
}

// 输入类型码，返回一帧的帧长(数据区长度，不包括：地址、类型码、校验码)
// 如果功能码未知，则返回0xFF，如果是需要进一步判断寄存器的，那么返回0xEEEE
uint8_t getFrame(uint8_t type)
{
    switch (type)
    {
        //	case	MOD_READ_LOOP:
        //读线圈
        //		case	MOD_READ_IN:
        //读输入寄存器
        //		case	MOD_READ_0_1:
        //读离散量
    case MOD_WRITE_S_WINDING:
        // 写单个线圈
    case MOD_READ_PARA:
        // 读保持寄存器
        return 0x04;
        // 数据区长度为4，连校验码长度共6个
        break;
    // case	MOD_WRITE_S_WINDING:
    //		// 写保持寄存器
    //		return	0xEEEE;
    //		break;
    case MOD_WRITE_PARA: // 写保持寄存器
        return 0x07;     // 单个数据，数据区长度为38，连校验码长度共40个(2字节起始寄存器地址，2字节寄存器数量，1字节写入数据的总字节数)
        break;
    default: // 未知功能码
        return 0xFF;
        break;
    }
}


// 查看停机的执行结果
// 本台低速启动失败判断处理	  +1表示  20mS
// 执行条件:	启动命令持续一个固定的时间,时间到后
//		检测执行结果
//		执行结果正确,则撤消该信号
//		执行结果错误,则判定为执行故障
// 取消待执行的命令
void Cancel_last_type(void)
{
    uint16_t static count = 0;
    if (ust.last_type != 0)
    {
        if (++count > 500)
        {
            count = 0;
            ust.last_type = 0; // 取消待执行事件
        }
    }
    else
    {
        count = 0;
    }
}

// 接收数据完毕，处理事件中，如分合闸复位保存参数等
// 0表示通讯设置正常
uint8_t Judge_Comm_Work1(void)
{
    // 波特率，疑问：为什么波特率=0属于正常？
    if (Device.BaudRate == 0)
    {
        return 0;
    }
    // 控制脚如果处于发送状态，属于错误
    if ((PAin(RS485_RE_Pin)) == 1)
    {
        return 1;
    }
    return 0;
}

// 超时处理，应该将所有的计数器等恢复初始状态
void Over_Time_Pro(uint8_t volatile Ot_cnt)
{
    if ((++ust.over_count) >= Ot_cnt)
    {
        // Receive_Wrong_Pro();
        ust.over_count = 0;
    }
}


//接收数据的处理
void Send_Ready(void)
{
    switch (Recv_MB.typecode)
    {
    case MOD_READ_PARA:
        // 读保持寄存器
        // MOD_READ_PARA_Pro();
        break;
    case MOD_WRITE_PARA:
        // 写保持寄存器
        // if ((WM.pro.item.ContChk == OPEN) || (WM.pro.item.ContChk == CLOSE)) //近控能否设置参数？
        // {
        //     MOD_WRITE_PARA_Pro();
        // }
        // else
        // {
        //     return_WRONG(MOD_WRITE_PARA, MOD_ERROR_WRITE_PARA);
        //     Cal_Checkout_and_Send();
        // }
        break;
    case MOD_WRITE_S_WINDING:
        // 写单个线圈
        // MOD_WRITE_S_WINDING_Pro();
        break;
    default:
        // 接收正确
        return_WRONG(MOD_READ_IN, MOD_ERROR_NOCOMMAND); //对于不认识的功能码暂不处理，暂用04错误代替
        Cal_Checkout_and_Send();
        break;
    }
}

void Cal_Checkout_and_Send(void)
{
    uint8_t volatile i;
    uint16_t crc;
    Send_MB.add = Device.Add_Comm; // 此AVR的地址
    i = Send_MB.frame;             // 取得帧长
    crc = CRC16(&Send_MB.add, i + 2);

    Send_MB.buffer[i] = crc & 0x00FF; // 先传低位
    Send_MB.buffer[i + 1] = crc >> 8; // 再传高位

    RS485_DE_Mode();
    // enable_DE();
    Send_MB.flag = TYPE_MATCH;     // 直接进入类型匹配模式，跳过地址模式
    ust.task_state = SEND_PRO_MSG; // 进入发送模式
    ust.over_count = 0;            // 超时计数器

    // 直接发送地址，因为不发送无法进入发送中断
    __HAL_UART_CLEAR_FLAG(&huart2, USART_FLAG_TC);
    HAL_UART_Transmit(&huart2, &Device.Add_Comm, 1, 1000);
    __HAL_UART_ENABLE_IT(&huart2, USART_IT_TXE);

    // USART_ClearFlag(USART2, USART_FLAG_TC);
    // USART_SendData(USART2, Device.Add_Comm);
    // USART_ITConfig(USART2, USART_IT_TXE, ENABLE); // 开启串口发送中断
}

void return_WRONG(uint8_t err, uint8_t err_num)
{
    // 返回	差错码
    Send_MB.typecode |= 0x80;
    // 返回	异常码
    Send_MB.buffer[0] = err_num;
    Send_MB.frame = 1;
    // 返回错误时数据区只有一个字节，即为错误err_num
}



// 接收到数据的处理，包含CRC校验
void Recv_Data_Process(void)
{
    uint8_t volatile i;
    uint16_t crc, sum;
    i = Recv_MB.frame; // 取得帧长
    crc = CRC16(&Recv_MB.add, i + 2);
    sum = (Recv_MB.buffer[i]) + (((uint16_t)(Recv_MB.buffer[i + 1])) << 8); // 配合本crc校验，高低位互换

    if (sum == crc)
    {
        ust.task_state = RCV_OVER_MSG; // 转为接收结束
        RS485_DE_Mode();
        // enable_DE();
    }
    else
    {
        ust.task_state = RCV_WRO_MSG; // 校验失败处理
    }
    ust.over_count = 0; // 超时计数器清零
}

void Receive_Wrong_Pro(void)
{
    ust.wait_task_main = BUFF_INIT_MSG; // 串口任务主状态（主程序中使用）：串口初始化
    // uart2_init(Device.BaudRate);
    MX_USART2_UART_Init();
    ust.task_state = WAI_WRO_PRO_MSG; // 串口任务状态：出错后等待串口复位
    RS485_RE_Mode();
}

//接收到错误数据，返回NONE_COMM_MSG状态
void Recv_Wrong_data_Process(void)
{
    ust.task_state = NONE_COMM_MSG; // 回到等待
    Buffer_int();
    RS485_DE_Mode();
}
